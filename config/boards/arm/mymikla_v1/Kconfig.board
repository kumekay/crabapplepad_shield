## config/boards/arm/mymikla_v1/Kconfig.board
```kconfig
# Mymikla V1 board configuration

# Copyright (c) 2024 The ZMK Contributors
# SPDX-License-Identifier: MIT

config BOARD_MYMIKLA_V1
    bool "Mymikla"
    depends on SOC_NRF52840_QIAA

config BOARD_MYMIKLA_V1_CHARGER
    bool "Enable battery charger"
    depends on BOARD_MYMIKLA_V1
```

## config/boards/arm/mymikla_v1/Kconfig.defconfig
```kconfig
# Mymikla V1 keyboard configuration

# Copyright (c) 2024 The ZMK Contributors
# SPDX-License-Identifier: MIT

if BOARD_MYMIKLA_V1

config ZMK_KEYBOARD_NAME
    default "Mymikla V1"

if USB_DEVICE_STACK

config USB_NRFX
    default y

endif # USB_DEVICE_STACK

config BT_CTLR
    default BT

endif # BOARD_MYMIKLA_V1
```

## config/boards/shields/crabapplepad/Kconfig.defconfig
```kconfig
# SPDX-FileCopyrightText: 2023 Sergei Silnov
# SPDX-License-Identifier: MIT

if SHIELD_CRABAPPLEPAD_LEFT

config ZMK_KEYBOARD_NAME
    default "crabapplepad"

config ZMK_SPLIT_ROLE_CENTRAL
    default y

endif

if SHIELD_CRABAPPLEPAD_LEFT || SHIELD_CRABAPPLEPAD_RIGHT

config ZMK_SPLIT
    default y

endif
```

## config/boards/shields/crabapplepad/Kconfig.shield
```kconfig
# SPDX-FileCopyrightText: 2023 Sergei Silnov
# SPDX-License-Identifier: MIT

config SHIELD_CRABAPPLEPAD_LEFT
    def_bool $(shields_list_contains,crabapplepad_left)

config SHIELD_CRABAPPLEPAD_RIGHT
    def_bool $(shields_list_contains,crabapplepad_right)
```

## config/boards/shields/crabapplepad_v2/Kconfig.defconfig
```kconfig
# SPDX-FileCopyrightText: 2024 Sergei Silnov
# SPDX-License-Identifier: MIT

if SHIELD_CRABAPPLEPAD_V2

config ZMK_KEYBOARD_NAME
    default "crabapad"

endif
```

## config/boards/shields/crabapplepad_v2/Kconfig.shield
```kconfig
# SPDX-FileCopyrightText: 2024 Sergei Silnov
# SPDX-License-Identifier: MIT

config SHIELD_CRABAPPLEPAD_V2
    def_bool $(shields_list_contains,crabapplepad_v2)
```
